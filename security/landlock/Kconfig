## security/landlock/Kconfig
```kconfig
# SPDX-License-Identifier: GPL-2.0-only

config SECURITY_LANDLOCK
	bool "Landlock support"
	depends on SECURITY
	select SECURITY_PATH
	help
	  Landlock is a safe sandboxing mechanism which enables processes to
	  restrict themselves (and their future children) by gradually
	  enforcing tailored access control policies.  A security policy is a
	  set of access rights (e.g. open a file in read-only, make a
	  directory) tied to a file hierarchy.  The configuration can be set by
	  any processes, including unprivileged ones, thanks to the landlock()
	  system call.

	  See Documentation/security/landlock/ for further information.

	  If you are unsure how to answer this question, answer N.
```

## security/seccomp/Kconfig
```kconfig
config SECURITY_SECCOMP
	bool "Seccomp LSM support"
	depends on AUDIT
	depends on SECCOMP
	depends on SECURITY
	default y
	help
	  This selects an extension to the Seccomp BPF to be able to filter
	  syscall arguments as kernel objects (e.g. file path).
	  This stacked LSM is needed to detect and block race-condition attacks
	  against argument evaluation (i.e. TOCTOU). Further information can be
	  found in Documentation/prctl/seccomp_filter.txt .

	  If you are unsure how to answer this question, answer Y.
```
